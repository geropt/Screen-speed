## esp/Firmware/components/map_sync/Kconfig
```kconfig
menu "map_sync (Capa B — tiles por zona)"

    config MAP_SYNC_TEST_CERT
        bool "Usar cert self-signed embebido (servidor de prueba)"
        default n
        help
            Si esta activo, map_sync verifica TLS contra el certificado embebido
            en components/map_sync/test_server_cert.pem (generarlo con
            `python map_test_server.py --print-cert > components/map_sync/test_server_cert.pem`).
            Si esta apagado, usa el certificate bundle de mbedTLS (produccion).
            La verificacion TLS esta SIEMPRE activa en ambos casos.

    config MAP_SYNC_BOOT_SELFTEST
        bool "Selftest de catalogo en el boot"
        default n
        help
            Si esta activo, app_main llama map_sync_selftest() en el boot: conecta
            WiFi STA, baja <base_url>/catalog.json, loguea las zonas y desconecta.
            Solo para validar el camino HTTPS+parseo del Incremento 2. Apagar en prod.

    config MAP_SYNC_VERIFY_SHA
        bool "Verificar sha256 de tiles locales ya presentes"
        default n
        help
            Si esta activo, antes de decidir bajar un tile que ya existe con el size
            correcto, se calcula su sha256 y se compara contra el manifiesto (mas
            I/O de SD). Por defecto solo se compara size + se verifica el sha256 del
            tile recien descargado. (Usado en el Incremento 5.)

endmenu
```

## esp/Firmware/main/Kconfig.projbuild
```kconfig
menu "SD/MMC Example Configuration"

    config EXAMPLE_FORMAT_IF_MOUNT_FAILED
        bool "Format the card if mount failed"
        default n
        help
            If this config item is set, format_if_mount_failed will be set to true and the card will be formatted if
            the mount has failed.

    config EXAMPLE_FORMAT_SD_CARD
        bool "Format the card as a part of the example"
        default n
        help
            If this config item is set, the card will be formatted as a part of the example.

    choice EXAMPLE_SDMMC_BUS_WIDTH
        prompt "SD/MMC bus width"
        default EXAMPLE_SDMMC_BUS_WIDTH_1
        help
            Select the bus width of SD or MMC interface.
            Note that even if 1 line mode is used, D3 pin of the SD card must have a pull-up resistor connected.
            Otherwise the card may enter SPI mode, the only way to recover from which is to cycle power to the card.

        config EXAMPLE_SDMMC_BUS_WIDTH_4
            bool "4 lines (D0 - D3)"

        config EXAMPLE_SDMMC_BUS_WIDTH_1
            bool "1 line (D0)"
    endchoice

    choice EXAMPLE_SDMMC_SPEED_MODE
        prompt "SD/MMC speed mode"
        default EXAMPLE_SDMMC_SPEED_DS

        config EXAMPLE_SDMMC_SPEED_DS
            bool "Default Speed"
        config EXAMPLE_SDMMC_SPEED_HS
            bool "High Speed"
        config EXAMPLE_SDMMC_SPEED_UHS_I_SDR50
            bool "UHS-I SDR50 (100 MHz, 50 MB/s)"
            depends on SOC_SDMMC_UHS_I_SUPPORTED
        config EXAMPLE_SDMMC_SPEED_UHS_I_DDR50
            bool "UHS-I DDR50 (50 MHz, 50 MB/s)"
            depends on SOC_SDMMC_UHS_I_SUPPORTED
    endchoice

    config EXAMPLE_PIN_CMD
        int
        prompt "CMD GPIO number" if SOC_SDMMC_USE_GPIO_MATRIX
        default 1 if IDF_TARGET_ESP32S3
        default 44 if IDF_TARGET_ESP32P4
        default 15 if IDF_TARGET_ESP32

    config EXAMPLE_PIN_CLK
        int
        prompt "CLK GPIO number" if SOC_SDMMC_USE_GPIO_MATRIX
        default 2 if IDF_TARGET_ESP32S3
        default 43 if IDF_TARGET_ESP32P4
        default 14 if IDF_TARGET_ESP32

    config EXAMPLE_PIN_D0
        int
        prompt "D0 GPIO number" if SOC_SDMMC_USE_GPIO_MATRIX
        default 3 if IDF_TARGET_ESP32S3
        default 39 if IDF_TARGET_ESP32P4
        default 2 if IDF_TARGET_ESP32

    if EXAMPLE_SDMMC_BUS_WIDTH_4

        config EXAMPLE_PIN_D1
            int
            prompt "D1 GPIO number" if SOC_SDMMC_USE_GPIO_MATRIX
            default 38 if IDF_TARGET_ESP32S3
            default 40 if IDF_TARGET_ESP32P4
            default 4 if IDF_TARGET_ESP32


        config EXAMPLE_PIN_D2
            int
            prompt "D2 GPIO number" if SOC_SDMMC_USE_GPIO_MATRIX
            default 33 if IDF_TARGET_ESP32S3
            default 41 if IDF_TARGET_ESP32P4
            default 12 if IDF_TARGET_ESP32


        config EXAMPLE_PIN_D3
            int
            prompt "D3 GPIO number" if SOC_SDMMC_USE_GPIO_MATRIX
            default 34 if IDF_TARGET_ESP32S3
            default 42 if IDF_TARGET_ESP32P4
            default 13 if IDF_TARGET_ESP32

    endif  # EXAMPLE_SDMMC_BUS_WIDTH_4

    config DEBUG_PIN_CONNECTIONS
        bool "Debug sd pin connections and pullup strength"
        default y

    config EXAMPLE_ENABLE_ADC_FEATURE
        bool "Enable ADC feature"
        depends on DEBUG_PIN_CONNECTIONS
        default y if IDF_TARGET_ESP32
        default n

    config EXAMPLE_ADC_UNIT
        int "ADC Unit"
        depends on EXAMPLE_ENABLE_ADC_FEATURE
        default 1 if IDF_TARGET_ESP32
        default 1

    config EXAMPLE_ADC_PIN_CLK
        int "CLK mapped ADC pin"
        depends on EXAMPLE_ENABLE_ADC_FEATURE
        default 6 if IDF_TARGET_ESP32
        default 1

    config EXAMPLE_ADC_PIN_CMD
        int "CMD mapped ADC pin"
        depends on EXAMPLE_ENABLE_ADC_FEATURE
        default 3 if IDF_TARGET_ESP32
        default 1

    config EXAMPLE_ADC_PIN_D0
        int "D0 mapped ADC pin"
        depends on EXAMPLE_ENABLE_ADC_FEATURE
        default 2 if IDF_TARGET_ESP32
        default 1

    if EXAMPLE_SDMMC_BUS_WIDTH_4

        config EXAMPLE_ADC_PIN_D1
            int "D1 mapped ADC pin"
            depends on EXAMPLE_ENABLE_ADC_FEATURE
            default 0 if IDF_TARGET_ESP32
            default 1

        config EXAMPLE_ADC_PIN_D2
            int "D2 mapped ADC pin"
            depends on EXAMPLE_ENABLE_ADC_FEATURE
            default 5 if IDF_TARGET_ESP32
            default 1

        config EXAMPLE_ADC_PIN_D3
            int "D3 mapped ADC pin"
            depends on EXAMPLE_ENABLE_ADC_FEATURE
            default 4 if IDF_TARGET_ESP32
            default 1

    endif  # EXAMPLE_SDMMC_BUS_WIDTH_4
endmenu

menu "NMEA Configuration"

    orsource "$IDF_PATH/examples/common_components/env_caps/$IDF_TARGET/Kconfig.env_caps"

    config NMEA_PARSER_UART_RXD
        int "UART RXD pin number"
        range ENV_GPIO_RANGE_MIN ENV_GPIO_IN_RANGE_MAX
        default 5 if !IDF_TARGET_ESP32H4
        default 15 if IDF_TARGET_ESP32H4
        help
            GPIO number for UART RX pin. See UART documentation for more information
            about available pin numbers for UART.

    config NMEA_PARSER_RING_BUFFER_SIZE
        int "NMEA Parser Ring Buffer Size"
        range 0 2048
        default 1024
        help
            Size of the ring buffer used for UART Rx channel.

    config NMEA_PARSER_TASK_STACK_SIZE
        int "NMEA Parser Task Stack Size"
        range 0 4096
        default 3072
        help
            Stack size of NMEA Parser task.

    config NMEA_PARSER_TASK_PRIORITY
        int "NMEA Parser Task Priority"
        range 0 24
        default 2
        help
            Priority of NMEA Parser task.

    menu "NMEA Statement Support"
        comment "At least one statement must be selected"
        config NMEA_STATEMENT_GGA
            bool "GGA Statement"
            default y
            help
                Enabling this option will parse the following parameter from GGA statement:

                - Latitude, Longitude, Altitude;
                - Number of satellites in use, fix status (no fix, GPS, DGPS), UTC time;

        config NMEA_STATEMENT_GSA
            bool "GSA Statement"
            default y
            help
                Enabling this option will parse the following parameter from GSA statement:

                - Position/Vertical/Horizontal dilution of precision;
                - Fix mode (no fix, 2D, 3D fix);
                - IDs of satellites in use;

        config NMEA_STATEMENT_GSV
            bool "GSV Statement"
            default y
            help
                Enabling this option will parse the following parameter from GSV statement:

                - Number of satellites in view;
                - Optional details of each satellite in view;

        config NMEA_STATEMENT_RMC
            bool "RMC Statement"
            default y
            help
                Enabling this option will parse the following parameter from RMC statement:

                - Validity of GPS signal;
                - Ground speed (knots) and course over ground (degrees);
                - Magnetic variation;
                - UTC date;

        config NMEA_STATEMENT_GLL
            bool "GLL Statement"
            default y
            help
                Enabling this option will parse the following parameter from GLL statement:

                - Latitude, Longitude;
                - UTC time;

        config NMEA_STATEMENT_VTG
            bool "VTG Statement"
            default y
            help
                Enabling this option will parse the following parameter from VTG statement:

                - Ground speed (knots, km/h) and course over ground (degrees);
                - Magnetic variation;

    endmenu

endmenu
```
