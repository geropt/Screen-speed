## esp/Firmware/components/board_waveshare_175/Kconfig
```kconfig
menu "Placa Waveshare 1.75"

    choice BOARD_LVGL_BUF_ROWS_CHOICE
        prompt "Filas por buffer de dibujo de LVGL"
        default BOARD_LVGL_BUF_ROWS_116
        help
            Cantidad de filas de cada uno de los dos buffers de dibujo, que se
            reservan en RAM interna con MALLOC_CAP_DMA.

            La línea base P00 usa 116 filas (466/4): 2 × 466 × 116 × 2 B =
            216 224 B internos. Con 32 filas el total baja a 59 648 B, o sea
            156 576 B (152,91 KiB) menos.

            Ese ahorro es aritmética del tamaño del buffer. Cambiar esta opción
            exige comparar en la placa, con la misma UI y el mismo replay, que la
            fluidez y los colores no empeoran: menos filas significa más
            transferencias por refresco. No cambiar esto junto con LVGL, el
            algoritmo de dibujo o el reloj del panel en el mismo paso.

        config BOARD_LVGL_BUF_ROWS_116
            bool "116 filas (línea base, 216 224 B)"
        config BOARD_LVGL_BUF_ROWS_64
            bool "64 filas (119 296 B)"
        config BOARD_LVGL_BUF_ROWS_48
            bool "48 filas (89 472 B)"
        config BOARD_LVGL_BUF_ROWS_32
            bool "32 filas (59 648 B)"
    endchoice

    config BOARD_LVGL_BUF_ROWS
        int
        default 116 if BOARD_LVGL_BUF_ROWS_116
        default 64  if BOARD_LVGL_BUF_ROWS_64
        default 48  if BOARD_LVGL_BUF_ROWS_48
        default 32  if BOARD_LVGL_BUF_ROWS_32

    config BOARD_ENABLE_TOUCH
        bool "Habilitar touch (CST92xx por I2C)"
        default n
        help
            Apagado en la línea base P00: el código del touch está compilado
            fuera y no se probó en la placa. Al habilitarlo, el touch usa el bus
            compartido de board_i2c y su ausencia no debe impedir que el HUD
            muestre velocidad.

            Pendiente antes de darlo por bueno: el fabricante documenta CST9217,
            el proyecto arrastra dependencia FT5x06 y el código usa
            TouchDrvCST92xx de SensorLib.

    config BOARD_ENABLE_IMU
        bool "Habilitar IMU"
        default n
        help
            No habilitar por defecto. El producto no usa la IMU para ninguna
            función acordada; encenderla sólo agrega consumo, un dueño de bus más
            y otra fuente de errores.

    config BOARD_ENABLE_AUDIO
        bool "Habilitar audio"
        default n
        help
            No habilitar por defecto. Igual criterio que la IMU: sin función
            acordada, no entra al arranque.

endmenu
```

## esp/Firmware/components/res_metrics/Kconfig
```kconfig
menu "Instrumentación de recursos"

    config RES_METRICS_ENABLE
        bool "Habilitar log periódico de recursos"
        default y
        help
            Los contadores y las latencias se acumulan siempre (cuesta unas pocas
            operaciones enteras por muestra); esta opción controla únicamente si
            se imprime el resumen periódico.

            Se deja en `y` durante P01 porque el objetivo de la etapa es saber
            cuánto margen hay antes de integrar red, mapas y app. Apagarlo no
            cambia el comportamiento medido, sólo silencia el log.

    config RES_METRICS_LOG_PERIOD_MS
        int "Período del resumen (ms)"
        default 30000
        range 1000 600000
        depends on RES_METRICS_ENABLE
        help
            Un resumen cada 30 s alcanza para ver tendencias sin ensuciar la
            consola. El plan pide logs acotados y prohíbe tráfico por píxel o por
            muestra.

endmenu
```

## esp/starlink_pilot/main/Kconfig.projbuild
```kconfig
menu "NMEA Configuration"

    config NMEA_PARSER_UART_RXD
        int "UART RXD pin number"
        default 16 if IDF_TARGET_ESP32
        default 18 if IDF_TARGET_ESP32S3
        default 16
        help
            GPIO of the TTL RX from the Ruptela RS232 converter.
            ESP32-WROOM: UART2 RX default GPIO16 (avoid UART1 on GPIO9/10, flash).
            ESP32-S3 DevKit: GPIO18, same as the HUD.

    config NMEA_PARSER_RING_BUFFER_SIZE
        int "NMEA Parser Ring Buffer Size"
        range 0 2048
        default 1024

    config NMEA_PARSER_UART_BAUD_RATE
        int "GPS UART initial baud rate"
        default 9600
        help
            First baud to probe. Auto-detects 9600 and 115200.

    config NMEA_PARSER_TASK_STACK_SIZE
        int "NMEA Parser Task Stack Size"
        range 2048 8192
        default 4096

    config NMEA_PARSER_TASK_PRIORITY
        int "NMEA Parser Task Priority"
        range 0 24
        default 2

    menu "NMEA Statement Support"
        config NMEA_STATEMENT_GGA
            bool "GGA Statement"
            default y
        config NMEA_STATEMENT_GSA
            bool "GSA Statement"
            default y
        config NMEA_STATEMENT_GSV
            bool "GSV Statement"
            default y
        config NMEA_STATEMENT_RMC
            bool "RMC Statement"
            default y
        config NMEA_STATEMENT_GLL
            bool "GLL Statement"
            default y
        config NMEA_STATEMENT_VTG
            bool "VTG Statement"
            default y
    endmenu
endmenu

menu "Starlink telematics"

    config TELEM_WIFI_SSID
        string "WiFi SSID (home / lab, 2.4 GHz)"
        default "Personal-916-2.4GHz"
        help
            ESP32 classic (WROOM) only sees 2.4 GHz. Use the 2.4 GHz SSID, not 5 GHz.

    config TELEM_WIFI_PASSWORD
        string "WiFi password for first SSID"
        default ""

    config TELEM_WIFI_SSID_2
        string "WiFi SSID 2 (office, 2.4 GHz)"
        default "ClaroRS"

    config TELEM_WIFI_PASSWORD_2
        string "WiFi password for second SSID"
        default ""

    config TELEM_WIFI_SSID_3
        string "WiFi SSID 3 (phone hotspot, 2.4 GHz)"
        default "iPhone"

    config TELEM_WIFI_PASSWORD_3
        string "WiFi password for third SSID"
        default ""

    config TELEM_HOST
        string "Ruptela TCP host"
        default "46973.flespi.gw"

    config TELEM_PORT
        int "Ruptela TCP port"
        default 29043
        range 1 65535

    config TELEM_T_DOWN_MS
        int "GPRS-down dwell before connecting (ms)"
        default 15000
        range 0 120000

    config TELEM_REQUIRE_IGNITION
        bool "Require IO 409 ignition on to open TCP"
        default n
endmenu
```

## esp/starlink_pilot/sdkconfig.defaults
```kconfig
CONFIG_IDF_TARGET="esp32"
CONFIG_ESPTOOLPY_FLASHSIZE_4MB=y
CONFIG_ESP_DEFAULT_CPU_FREQ_MHZ_160=y
CONFIG_NMEA_PARSER_UART_RXD=16
CONFIG_NMEA_PARSER_UART_BAUD_RATE=9600
CONFIG_NMEA_PARSER_TASK_STACK_SIZE=4096
CONFIG_TELEM_WIFI_SSID="Personal-916-2.4GHz"
CONFIG_TELEM_WIFI_PASSWORD=""
CONFIG_TELEM_WIFI_SSID_2="ClaroRS"
CONFIG_TELEM_WIFI_PASSWORD_2=""
CONFIG_TELEM_WIFI_SSID_3="iPhone"
CONFIG_TELEM_WIFI_PASSWORD_3=""
CONFIG_TELEM_HOST="46973.flespi.gw"
CONFIG_TELEM_PORT=29043
CONFIG_TELEM_T_DOWN_MS=15000
# CONFIG_TELEM_REQUIRE_IGNITION is not set
```
